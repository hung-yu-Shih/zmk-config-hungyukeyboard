## config/boards/shields/hungyukeyboard/Kconfig.defconfig
```kconfig
if SHIELD_HUNGYUKEYBOARD

config ZMK_KEYBOARD_NAME
    default "Hungyu的鍵盤"

endif
```

## config/boards/shields/hungyukeyboard/Kconfig.shield
```kconfig
config SHIELD_HUNGYUKEYBOARD
    def_bool $(shields_list_contains,hungyukeyboard)
```
