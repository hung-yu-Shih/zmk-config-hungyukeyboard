#include <dt-bindings/zmk/matrix_transform.h>

/ {
    chosen {
        zmk,kscan = &kscan0;
    };

    kscan0: kscan {
        compatible = "zmk,kscan-gpio-matrix";
        wakeup-source;

        row-gpios
            = <&gpio0 17 GPIO_ACTIVE_LOW>;

        col-gpios
            = <&gpio0 20 GPIO_ACTIVE_LOW>;
    };
};
